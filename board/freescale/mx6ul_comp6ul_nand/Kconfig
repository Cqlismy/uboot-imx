## board/freescale/mx6ul_comp6ul_nand/Kconfig
```kconfig
if TARGET_MX6UL_COMP6UL_NAND

config SYS_BOARD
	default "mx6ul_comp6ul_nand"

config SYS_VENDOR
	default "freescale"

config SYS_CONFIG_NAME
	default "mx6ul_comp6ul_nand"

endif
```

## configs/mx6ul_comp6ul_nand_defconfig
```kconfig
CONFIG_ARM=y
CONFIG_ARCH_MX6=y
CONFIG_TARGET_MX6UL_COMP6UL_NAND=y
CONFIG_SYS_EXTRA_OPTIONS="IMX_CONFIG=board/freescale/mx6ul_comp6ul_nand/imximage.cfg,SYS_BOOT_NAND"
CONFIG_CMD_GPIO=y
CONFIG_CMD_DHCP=y
CONFIG_CMD_PING=y
```
